## drivers/staging/zram/Kconfig
```kconfig
config ZRAM
	tristate "Compressed RAM block device support"
	depends on BLOCK && SYSFS && ZSMALLOC
	select LZO_COMPRESS
	select LZO_DECOMPRESS
	default n
	help
	  Creates virtual block devices called /dev/zramX (X = 0, 1, ...).
	  Pages written to these disks are compressed and stored in memory
	  itself. These disks allow very fast I/O and compression provides
	  good amounts of memory savings.

	  It has several use cases, for example: /tmp storage, use as swap
	  disks and maybe many more.

	  See zram.txt for more information.
	  Project home: <https://compcache.googlecode.com/>

config ZRAM_LZ4
	bool "Use LZ4 instead of LZO for zram"
	depends on ZRAM
	select LZ4_COMPRESS
	select LZ4_DECOMPRESS
	default y
	help
	  A1000: LZ4 распаковывает в разы быстрее LZO при чуть худшем сжатии.
	  Для свопа в память важна именно скорость чтения: страницу достают из
	  zram на горячем пути обращения к памяти, и там дорога каждая
	  микросекунда. Сжимает LZ4 тоже быстрее, то есть процессор меньше
	  времени проводит на высокой частоте.

config ZRAM_DEBUG
	bool "Compressed RAM block device debug support"
	depends on ZRAM
	default n
	help
	  This option adds additional debugging code to the compressed
	  RAM block device driver.
```
